// GENERATED by tools/build_page.py from firmware/local_page.html. Edit that file, not this one.
#pragma once
const char PAGE[] = R"rawliteral(<!doctype html>
<html lang="en">
<head>
<meta charset="utf-8">
<meta name="viewport" content="width=device-width,initial-scale=1">
<title>Gas Monitor</title>
<style>
:root{
  --bg:#f3f2ee;--card:#ffffff;--fg:#1c1c1a;--muted:#6d6c66;--line:#e2e0d9;--track:#ecebe5;
  --ok:#2e8b57;--warn:#d4891c;--low:#c94a3a;--c1:#2f6fb0;--c2:#c46a1f;
}
@media (prefers-color-scheme:dark){
  :root{--bg:#121211;--card:#1c1c1a;--fg:#efeee8;--muted:#9b9a92;--line:#2f2f2b;--track:#292926;--c1:#6aa6e8;--c2:#ec9a52;--ok:#4caf7a}
}
*{box-sizing:border-box}
body{margin:0;background:var(--bg);color:var(--fg);font:15px/1.4 system-ui,-apple-system,"Segoe UI",Roboto,sans-serif}
.wrap{max-width:980px;margin:0 auto;padding:20px 16px 40px}
header{display:flex;flex-wrap:wrap;align-items:flex-end;justify-content:space-between;gap:14px;margin-bottom:16px}
h1{margin:0;font-size:24px;letter-spacing:-.01em}
.sub{color:var(--muted);font-size:13px;margin-top:2px}
.summary{display:flex;gap:10px;flex-wrap:wrap}
.chip{background:var(--card);border:1px solid var(--line);border-radius:12px;padding:8px 14px;min-width:110px}
.chip .k{font-size:11px;color:var(--muted);text-transform:uppercase;letter-spacing:.05em}
.chip .v{font-size:17px;font-weight:650;white-space:nowrap}
.grid{display:grid;grid-template-columns:1fr;gap:14px}
@media(min-width:720px){.grid{grid-template-columns:1fr 1fr}}
.card{background:var(--card);border:1px solid var(--line);border-radius:16px;padding:18px}
.tank{display:flex;gap:18px}
.cyl{flex:0 0 72px}
.cyl svg{width:72px;height:auto;display:block}
.info{flex:1;min-width:0}
@media(max-width:480px){.tank{gap:14px}.cyl{flex-basis:52px}.cyl svg{width:52px}.rows{font-size:13.5px}}
.top{display:flex;align-items:center;justify-content:space-between;gap:8px}
.name{font-weight:650;font-size:16px;display:flex;align-items:center;gap:8px}
.dot{width:10px;height:10px;border-radius:50%;flex:none}
.badge{font-size:12px;padding:3px 10px;border-radius:999px;background:var(--track);color:var(--muted);white-space:nowrap}
.badge.use{background:color-mix(in srgb,var(--ok) 18%,transparent);color:var(--ok)}
.badge.bad{background:color-mix(in srgb,var(--low) 16%,transparent);color:var(--low)}
.pct{font-size:44px;font-weight:700;line-height:1.05;margin-top:6px;letter-spacing:-.02em}
.kg{color:var(--muted);font-size:14px}
.rows{margin-top:12px;display:grid;grid-template-columns:auto 1fr;gap:6px 14px;font-size:14px}
.rows .k{color:var(--muted)}
.rows .v{text-align:right;font-weight:550}
.foot{margin-top:12px;font-size:12px;color:var(--muted);overflow-wrap:anywhere}
.hist{margin-top:14px}
.hhead{display:flex;justify-content:space-between;align-items:center;flex-wrap:wrap;gap:10px;margin-bottom:10px}
.seg{display:inline-flex;background:var(--track);border-radius:10px;padding:3px}
.seg button{border:0;background:transparent;color:var(--muted);font:inherit;font-size:13px;padding:5px 12px;border-radius:8px;cursor:pointer}
.seg button.on{background:var(--card);color:var(--fg);box-shadow:0 1px 3px rgba(0,0,0,.12)}
.legend{display:flex;gap:14px;font-size:13px;color:var(--muted);flex-wrap:wrap}
.legend span{display:inline-flex;align-items:center;gap:6px}
.cw{position:relative;touch-action:pan-y}
#chart{width:100%;height:260px;display:block}
.tip{position:absolute;top:8px;pointer-events:none;background:var(--card);border:1px solid var(--line);border-radius:8px;padding:6px 9px;font-size:12px;box-shadow:0 4px 14px rgba(0,0,0,.14);display:none;white-space:nowrap}
.demo{background:color-mix(in srgb,var(--warn) 18%,transparent);border-radius:10px;padding:8px 12px;font-size:13px;margin-bottom:14px;display:none}
</style>
</head>
<body>
<div class="wrap">
  <div class="demo" id="demo">Demo data: this page isn't connected to the ESP32, so it's showing sample readings.</div>
  <header>
    <div>
      <h1>Gas Monitor</h1>
      <div class="sub" id="sub">Connecting…</div>
    </div>
    <div class="summary">
      <div class="chip"><div class="k">Gas left</div><div class="v" id="sTotal">–</div></div>
      <div class="chip"><div class="k">Usage</div><div class="v" id="sRate">–</div></div>
      <div class="chip"><div class="k">All tanks empty</div><div class="v" id="sEmpty">–</div></div>
    </div>
  </header>

  <div class="grid" id="tanks"></div>

  <div class="card hist">
    <div class="hhead">
      <div class="name">History</div>
      <div class="legend" id="legend"></div>
      <div class="seg" id="seg">
        <button data-h="24">24 h</button><button data-h="168" class="on">7 days</button><button data-h="720">30 days</button>
      </div>
    </div>
    <div class="cw" id="cw"><svg id="chart"></svg><div class="tip" id="tip"></div></div>
  </div>
</div>

<script>
const $ = id => document.getElementById(id);
const COLORS = ['var(--c1)', 'var(--c2)', '#7a5cc2', '#3a9b8f'];
let demo = false, state = null, hist = null, range = 168, series = [], geom = null;

const lvlColor = p => p == null ? 'var(--muted)' : p < 15 ? 'var(--low)' : p < 30 ? 'var(--warn)' : 'var(--ok)';
const fmtDate = s => new Date(s * 1000).toLocaleDateString('en-ZA', {weekday: 'short', day: 'numeric', month: 'short'});
const fmtAge = s => s < 60 ? s + ' s ago' : s < 3600 ? Math.round(s / 60) + ' min ago' : Math.round(s / 3600) + ' h ago';
const tankName = i => state && state.tanks[i] ? state.tanks[i].name : 'Tank ' + (i + 1);

async function getJSON(u) {
  const r = await fetch(u, {cache: 'no-store'});
  if (!r.ok) throw new Error(r.status);
  return r.json();
}

function status(t) {
  if (!t.valid || t.age_s > 900) return ['No signal', 'bad'];
  if (t.quality === 0) return ['No reading', 'bad'];
  if (t.rate_kg_day != null && t.rate_kg_day >= 0.1) return ['In use', 'use'];
  return ['Standby', ''];
}

function signal(r) {
  if (r == null) return '–';
  return (r >= -70 ? 'Good' : r >= -85 ? 'OK' : 'Weak') + ' · ' + r + ' dBm';
}

function cylinder(p, i) {
  const h = 160 * (p || 0) / 100;
  return `<svg viewBox="0 0 80 200" aria-hidden="true">
    <defs><clipPath id="cb${i}"><rect x="8" y="34" width="64" height="160" rx="24"/></clipPath></defs>
    <rect x="31" y="4" width="18" height="10" rx="2" fill="var(--muted)" opacity=".5"/>
    <rect x="36" y="13" width="8" height="8" fill="var(--muted)" opacity=".5"/>
    <path d="M20 36 V24 Q20 19 25 19 H55 Q60 19 60 24 V36" fill="none" stroke="var(--line)" stroke-width="5"/>
    <rect x="8" y="34" width="64" height="160" rx="24" fill="var(--track)"/>
    <rect clip-path="url(#cb${i})" x="8" y="${194 - h}" width="64" height="${h}" fill="${lvlColor(p)}" opacity=".88"/>
    <rect x="8" y="34" width="64" height="160" rx="24" fill="none" stroke="var(--line)" stroke-width="2"/>
  </svg>`;
}

function tankCard(t, i) {
  const p = t.percent;
  const [st, cls] = status(t);
  let empty = '–';
  if (t.days_left != null) {
    const d = t.days_left;
    empty = '~' + (d < 2 ? Math.round(d * 24) + ' h' : Math.round(d) + ' days') + ' · ' + fmtDate(t.empty_at);
  }
  const rate = t.rate_kg_day == null ? 'Learning…' : t.rate_kg_day < 0.1 ? 'Idle' : t.rate_kg_day.toFixed(2) + ' kg/day';
  const rows = [
    ['Usage', rate],
    ['Used last 24 h', t.used_24h == null ? '–' : t.used_24h.toFixed(1) + ' kg'],
    ['Empty in', empty],
    ['Temperature', t.temp_c == null ? '–' : t.temp_c + ' °C'],
    ['Sensor battery', t.battery_v == null ? '–' : t.battery_pct + '% · ' + t.battery_v.toFixed(2) + ' V'],
    ['Signal', signal(t.rssi)],
    ['Liquid height', t.level_mm == null ? '–' : t.level_mm + ' mm · quality ' + t.quality + '/3'],
  ].map(([k, v]) => `<div class="k">${k}</div><div class="v">${v}</div>`).join('');
  return `<div class="card tank">
    <div class="cyl">${cylinder(p, i)}</div>
    <div class="info">
      <div class="top"><div class="name"><span class="dot" style="background:${COLORS[i]}"></span>${t.name}</div><span class="badge ${cls}">${st}</span></div>
      <div class="pct" style="color:${lvlColor(p)}">${p == null ? '–' : Math.round(p) + '%'}</div>
      <div class="kg">${t.kg == null ? '–' : t.kg.toFixed(1)} of ${t.capacity_kg} kg</div>
      <div class="rows">${rows}</div>
      <div class="foot">${t.mac}${t.valid ? ' · updated ' + fmtAge(t.age_s) : ''}</div>
    </div>
  </div>`;
}

function render() {
  if (!state) return;
  const ts = state.tanks;
  $('tanks').innerHTML = ts.map(tankCard).join('');
  let kg = 0, cap = 0, rate = 0, any = false;
  ts.forEach(t => {
    cap += t.capacity_kg;
    if (t.kg != null) { kg += t.kg; any = true; }
    if (t.rate_kg_day != null && t.rate_kg_day >= 0.1) rate += t.rate_kg_day;
  });
  $('sTotal').textContent = any ? kg.toFixed(0) + ' / ' + cap + ' kg' : '–';
  $('sRate').textContent = rate > 0 ? rate.toFixed(2) + ' kg/day' : '–';
  const days = rate > 0 && any ? kg / rate : null;
  $('sEmpty').textContent = days ? '~' + Math.round(days) + ' days · ' + fmtDate(state.now + days * 86400) : '–';
  const ages = ts.filter(t => t.valid).map(t => t.age_s);
  $('sub').textContent = ts.length + ' tanks · ' + (ages.length ? 'updated ' + fmtAge(Math.min(...ages)) : 'waiting for sensors');
  $('legend').innerHTML = ts.map((t, i) => `<span><span class="dot" style="background:${COLORS[i]}"></span>${t.name}</span>`).join('');
}

function xTicks(from, to) {
  const out = [], span = to - from;
  if (span <= 86400 * 1.01) {
    const d = new Date(from * 1000); d.setMinutes(0, 0, 0);
    for (let t = d.getTime() / 1000; t <= to; t += 3600) {
      const h = new Date(t * 1000).getHours();
      if (t >= from && h % 4 === 0) out.push([t, String(h).padStart(2, '0') + ':00']);
    }
  } else {
    const d = new Date(from * 1000); d.setHours(0, 0, 0, 0);
    const daily = span <= 8 * 86400;
    for (let k = 0; d.getTime() / 1000 <= to; k++, d.setDate(d.getDate() + 1)) {
      const t = d.getTime() / 1000;
      if (t < from) continue;
      if (daily) out.push([t, d.toLocaleDateString('en-ZA', {weekday: 'short'})]);
      else if (d.getDate() % 5 === 1) out.push([t, d.toLocaleDateString('en-ZA', {day: 'numeric', month: 'short'})]);
    }
  }
  return out;
}

function drawChart() {
  const svg = $('chart');
  if (!hist) return;
  const W = svg.clientWidth || 600, H = 260, L = 42, R = 12, T = 12, B = 28;
  svg.setAttribute('viewBox', `0 0 ${W} ${H}`);
  const now = state ? state.now : Date.now() / 1000, from = now - range * 3600;
  const X = t => L + (t - from) / (now - from) * (W - L - R);
  const Y = p => T + (1 - p / 100) * (H - T - B);
  let g = '';
  for (const p of [0, 25, 50, 75, 100]) {
    g += `<line x1="${L}" x2="${W - R}" y1="${Y(p)}" y2="${Y(p)}" stroke="var(--line)"/>`;
    g += `<text x="${L - 8}" y="${Y(p) + 4}" text-anchor="end" font-size="11" fill="var(--muted)">${p}%</text>`;
  }
  for (const [t, lab] of xTicks(from, now)) {
    const x = X(t);
    g += `<line x1="${x}" x2="${x}" y1="${T}" y2="${H - B}" stroke="var(--line)" stroke-dasharray="2 4"/>`;
    g += `<text x="${x}" y="${H - 8}" text-anchor="middle" font-size="11" fill="var(--muted)">${lab}</text>`;
  }
  series = (hist.tanks || []).map(s => {
    const pts = [];
    for (let k = 0; k < s.m.length; k++) {
      const t = hist.t0 + s.m[k] * 60;
      if (t >= from) pts.push([t, s.p[k]]);
    }
    return pts;
  });
  let total = 0;
  series.forEach((pts, i) => {
    let d = '', prev = null;
    for (const [t, p] of pts) {
      d += (prev == null || t - prev > 2700 ? 'M' : 'L') + X(t).toFixed(1) + ' ' + Y(p).toFixed(1);
      prev = t;
    }
    total += pts.length;
    g += `<path d="${d}" fill="none" stroke="${COLORS[i]}" stroke-width="2" stroke-linejoin="round" stroke-linecap="round"/>`;
  });
  if (!total) g += `<text x="${(L + W - R) / 2}" y="${H / 2}" text-anchor="middle" font-size="13" fill="var(--muted)">Collecting history: the first point appears after 15 minutes</text>`;
  g += `<line id="xh" y1="${T}" y2="${H - B}" stroke="var(--muted)" visibility="hidden"/>`;
  series.forEach((_, i) => { g += `<circle id="mk${i}" r="4" fill="${COLORS[i]}" stroke="var(--card)" stroke-width="2" visibility="hidden"/>`; });
  svg.innerHTML = g;
  geom = {X, Y, L, R, W, from, now};
}

function nearest(pts, t) {
  let lo = 0, hi = pts.length - 1;
  if (hi < 0) return null;
  while (lo < hi) { const mid = (lo + hi) >> 1; if (pts[mid][0] < t) lo = mid + 1; else hi = mid; }
  if (lo > 0 && Math.abs(pts[lo - 1][0] - t) < Math.abs(pts[lo][0] - t)) lo--;
  return pts[lo];
}

function hideTip() {
  $('tip').style.display = 'none';
  const xh = $('xh'); if (xh) xh.setAttribute('visibility', 'hidden');
  series.forEach((_, i) => { const m = $('mk' + i); if (m) m.setAttribute('visibility', 'hidden'); });
}

$('cw').addEventListener('pointermove', e => {
  if (!geom) return;
  const r = $('chart').getBoundingClientRect(), x = e.clientX - r.left;
  const {X, Y, L, R, W, from, now} = geom;
  if (x < L || x > W - R) return hideTip();
  const t = from + (x - L) / (W - L - R) * (now - from);
  const tol = Math.max(1800, (now - from) / 120);
  const rows = [];
  series.forEach((pts, i) => {
    const pt = nearest(pts, t), mk = $('mk' + i);
    if (pt && Math.abs(pt[0] - t) < tol) {
      mk.setAttribute('cx', X(pt[0])); mk.setAttribute('cy', Y(pt[1])); mk.setAttribute('visibility', 'visible');
      const cap = state && state.tanks[i] ? state.tanks[i].capacity_kg : 48;
      rows.push(`<div><span style="color:${COLORS[i]}">●</span> ${tankName(i)}: ${pt[1].toFixed(1)}% · ${(pt[1] * cap / 100).toFixed(1)} kg</div>`);
    } else mk.setAttribute('visibility', 'hidden');
  });
  const xh = $('xh'); xh.setAttribute('x1', x); xh.setAttribute('x2', x); xh.setAttribute('visibility', 'visible');
  const tip = $('tip');
  tip.innerHTML = `<div style="color:var(--muted)">${new Date(t * 1000).toLocaleString('en-ZA', {weekday: 'short', day: 'numeric', month: 'short', hour: '2-digit', minute: '2-digit'})}</div>` + (rows.join('') || '<div>No data</div>');
  tip.style.display = 'block';
  tip.style.left = (x < W / 2 ? x + 12 : x - tip.offsetWidth - 12) + 'px';
});
$('cw').addEventListener('pointerleave', hideTip);

$('seg').addEventListener('click', e => {
  const b = e.target.closest('button'); if (!b) return;
  range = +b.dataset.h;
  [...$('seg').children].forEach(x => x.classList.toggle('on', x === b));
  hideTip(); drawChart();
});
window.addEventListener('resize', () => { hideTip(); drawChart(); });

function enterDemo() {
  demo = true;
  $('demo').style.display = 'block';
  const now = Math.floor(Date.now() / 1000), step = 900, n = 2880, t0 = now - (n - 1) * step;
  let seed = 7; const rand = () => (seed = (seed * 16807) % 2147483647) / 2147483647;
  const A = {m: [], p: []}, B = {m: [], p: []};
  let pa = 60; const refillAt = Math.round(n * 0.6);
  for (let k = 0; k < n; k++) {
    const t = t0 + k * step, h = new Date(t * 1000).getHours();
    const use = (h >= 6 && h < 9) ? 3 : (h >= 17 && h < 22) ? 4 : 0.6;
    pa = Math.max(0, pa - use * 0.0189);
    if (k === refillAt) pa = 96;
    const wob = Math.sin((h - 14) / 24 * 2 * Math.PI) * 0.4;
    A.m.push(k * 15); A.p.push(+(pa + wob + (rand() - .5) * 0.5).toFixed(1));
    B.m.push(k * 15); B.p.push(+(97 + wob + (rand() - .5) * 0.4).toFixed(1));
  }
  hist = {t0, tanks: [A, B]};
  const mk = (name, mac, p, rate, used, temp, bv, rssi) => {
    const kg = 48 * p / 100, d = rate >= 0.1 ? kg / rate : null;
    return {name, mac, capacity_kg: 48, valid: true, age_s: Math.round(rand() * 20), quality: 3,
      level_mm: Math.round(20 + p / 100 * 880), percent: p, kg, temp_c: temp, battery_v: bv, battery_pct: 100, rssi,
      rate_kg_day: rate, used_24h: used, days_left: d, empty_at: d ? now + d * 86400 : null};
  };
  state = {now, tanks: [
    mk('Tank 1', 'f1:81:73:69:2c:5b', A.p[n - 1], 1.40, 1.4, 24, 3.19, -79),
    mk('Tank 2', 'e9:e1:cf:08:46:7c', B.p[n - 1], 0, 0, 23, 3.25, -58),
  ]};
}

async function refreshState() {
  try { state = await getJSON('/api/state'); render(); }
  catch (e) { $('sub').textContent = 'ESP32 not reachable, retrying…'; }
}
async function refreshHist() {
  try { hist = await getJSON('/api/history?hours=720'); drawChart(); } catch (e) {}
}

async function init() {
  try {
    state = await getJSON('/api/state');
    hist = await getJSON('/api/history?hours=720');
  } catch (e) { enterDemo(); }
  render(); drawChart();
  if (!demo) { setInterval(refreshState, 10000); setInterval(refreshHist, 300000); }
}
init();
</script>
</body>
</html>
)rawliteral";
